## meta-aesd/conf/layer.conf
```bitbake
# We have a conf and classes directory, add to BBPATH
BBPATH .= ":${LAYERDIR}"

# We have recipes-* directories, add to BBFILES
BBFILES += "${LAYERDIR}/recipes-*/*/*.bb \
            ${LAYERDIR}/recipes-*/*/*.bbappend"

BBFILE_COLLECTIONS += "meta-aesd"
BBFILE_PATTERN_meta-aesd = "^${LAYERDIR}/"
BBFILE_PRIORITY_meta-aesd = "6"

LAYERDEPENDS_meta-aesd = "core"
LAYERSERIES_COMPAT_meta-aesd = "dunfell"
```

## meta-gui/conf/layer.conf
```bitbake
# We have a conf and classes directory, add to BBPATH 
BBPATH := "${BBPATH}:${LAYERDIR}" 

# We have a packages directory, add to BBFILES 
BBFILES := "${BBFILES} ${LAYERDIR}/recipes-*/*/*.bb \ 
            ${LAYERDIR}/recipes-*/*/*.bbappend" 

LAYERSERIES_COMPAT_meta-gui = "honister"

BBFILE_COLLECTIONS += "meta-gui" 
BBFILE_PATTERN_meta-gui:= "^${LAYERDIR}/" 
BBFILE_PRIORITY_meta-gui:= "6"

LAYERDEPENDS_gpio= "core"
```

## meta-spi/conf/layer.conf
```bitbake
# We have a conf and classes directory, add to BBPATH
BBPATH .= ":${LAYERDIR}"

# We have recipes-* directories, add to BBFILES
BBFILES += "${LAYERDIR}/recipes-*/*/*.bb \
            ${LAYERDIR}/recipes-*/*/*.bbappend"

BBFILE_COLLECTIONS += "meta-spi"
BBFILE_PATTERN_meta-spi = "^${LAYERDIR}/"
BBFILE_PRIORITY_meta-spi = "5"

LAYERDEPENDS_meta-spi = "core"
LAYERSERIES_COMPAT_meta-spi = "kirkstone"
```
